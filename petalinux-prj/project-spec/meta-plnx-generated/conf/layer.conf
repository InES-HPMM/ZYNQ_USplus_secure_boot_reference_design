## petalinux-prj/project-spec/meta-plnx-generated/conf/layer.conf
```bitbake
# We have a conf and classes directory, add to BBPATH
BBPATH .= ":${LAYERDIR}"

# We have recipes-* directories, add to BBFILES
BBFILES += "${LAYERDIR}/recipes-*/*/*.bb \
            ${LAYERDIR}/recipes-*/*/*.bbappend"

BBFILE_COLLECTIONS += "meta-plnx-generated"
BBFILE_PATTERN_meta-plnx-generated = "^${LAYERDIR}/"
BBFILE_PRIORITY_meta-plnx-generated = "6"

LAYERDEPENDS_meta-plnx-generated = "core"
LAYERSERIES_COMPAT_meta-plnx-generated = "thud"
```

## petalinux-prj/project-spec/meta-plnx-generated/conf/machine/plnx-zynqmp.conf
```bitbake
require conf/machine/include/tune-zynqmp.inc
require conf/machine/include/machine-xilinx-overrides.inc
require conf/machine/include/machine-xilinx-default.inc
require conf/machine/include/machine-xilinx-board.inc

include conf/machine/include/zynqmp-pmu-config.inc

SERIAL_CONSOLES_CHECK = "${SERIAL_CONSOLES}"
MACHINE_FEATURES = "rtc ext2 ext3 vfat usbhost"
```
